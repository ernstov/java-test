## sample.yaml
```yaml
namespace: sample
sample:
  defines: runnable
  metadata:
    name: sample
    description: Sample Java Application
    icon: https://emojiapi.dev/api/v1/robot.svg
  containers:
    sample:
      build: .
      image: env-1566.registry.local/sample:main-53eedd9
  services:
    spring-boot:
      container: sample
      port: 8080
      host-port: 8080
      publish: false
      protocol: TCP
      description: Default Spring Boot port.
  connections:
    database:
      target: sample/db
      service: postgres
  variables:
    database-url:
      env: DATABASE_URL
      type: string
      description: URL for the PostgreSQL database
      value: <- connection-hostname("database")
db:
  defines: runnable
  inherits: postgresql/db
stack:
  defines: group
  members:
    - sample/sample
    - sample/db
```
